## Code/Kconfig
```kconfig
mainmenu "ODIN Flight Computer"

source "Kconfig.zephyr"

menu "ODIN application"

config ODIN_HIL_SIM
	bool "Use a motor-profile hardware-in-the-loop simulation"
	default n
	help
	  Replace the physical IMU, high-g accelerometer, and barometer readings
	  with a compiled-in flight profile. The normal estimator, flight-state
	  machine, radio, flash logger, GPS, CAN, watchdog, and RTOS scheduling
	  continue to run on the flight computer. Pyrotechnic outputs are locked
	  inactive whenever this option is enabled.

choice ODIN_SIM_PROFILE
	prompt "Motor profile"
	depends on ODIN_HIL_SIM
	default ODIN_SIM_PROFILE_2000M

config ODIN_SIM_PROFILE_2000M
	bool "2,000 m full-flight profile"
	help
	  Scale the L1365 altitude and net vertical acceleration consistently so
	  the simulated trajectory reaches exactly 2,000 m AGL before descending
	  to the ground.

config ODIN_SIM_PROFILE_M2050
	bool "M2050"

config ODIN_SIM_PROFILE_L1365
	bool "L1365"

config ODIN_SIM_PROFILE_L1400
	bool "L1400"

config ODIN_SIM_PROFILE_L820
	bool "L820"

config ODIN_SIM_PROFILE_K1200
	bool "K1200"

config ODIN_SIM_PROFILE_J435
	bool "J435"

endchoice

config ODIN_SIM_AUTO_START
	bool "Automatically arm and start the simulation"
	depends on ODIN_HIL_SIM
	default n
	help
	  Arm the flight-state machine immediately before releasing the scheduler.
	  This option is simulation-only; ODIN_HIL_SIM also compiles out physical
	  pyrotechnic activation and holds every pyro output inactive.

config ODIN_SIM_CONTINUITY_PRESENT
	bool "Report both igniter continuity channels as present"
	depends on ODIN_HIL_SIM
	default y
	help
	  Lets the normal ground-station arming workflow run without igniters or
	  continuity resistors connected. This changes only reported continuity;
	  the physical pyrotechnic outputs remain locked inactive.

endmenu
```

## Code/dts/bindings/misc/odin,flight-io.yaml
```yaml
description: ODIN flight computer discrete and analogue IO

compatible: "odin,flight-io"

include: base.yaml

properties:
  drogue-pyro-gpios:
    type: phandle-array
    required: true
  main-pyro-gpios:
    type: phandle-array
    required: true
  aux-pyro-gpios:
    type: phandle-array
    required: true
  buzzer-gpios:
    type: phandle-array
    required: true
  lora-reset-gpios:
    type: phandle-array
    required: true
  lora-dio0-gpios:
    type: phandle-array
    required: true
  gps-reset-gpios:
    type: phandle-array
    required: true
  io-channels:
    type: phandle-array
    required: true
  io-channel-names:
    type: string-array
    required: true
```

## Code/dts/bindings/misc/odin,raw-spi.yaml
```yaml
description: ODIN application-managed raw SPI peripheral

compatible: "odin,raw-spi"

include: spi-device.yaml
```
